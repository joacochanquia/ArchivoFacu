PIC 	EQU 	20H
TIMER 	EQU 	10H
PIO 	EQU 	30H
N_CLK 	EQU 	10
	ORG 	40
IP_CLK 	DW 	RUT_CLK
	ORG 	1000H
INICIO 	DB	1
	ORG 	3000H
ROTARIZ: ADD 	AL, AL
	 ADC	AL, 0
	 DEC	CL
	 JNZ	ROTARIZ
	 RET
ROTARDER:MOV 	CL, 7
	 CALL	ROTARIZ
	 RET
RUT_CLK:PUSH	AX
	PUSH	CX
	MOV 	AL, INICIO
	CMP	DH, 00H
	JNZ	BAJO
	ADD 	AL, AL
	CMP	AL, 80H
	JNZ	FIN_C
	MOV	DH, 0FFH
	JMP	FIN_C	
BAJO:	CALL	ROTARDER
	CMP	AL, 01H
	JNZ	FIN_C
	MOV	DH, 00H
FIN_C:	MOV	INICIO, AL
 	OUT	PIO+1, AL
	MOV 	AL, 0
	OUT 	TIMER, AL
	MOV 	AL, 20H
	OUT 	PIC, AL
	POP	CX
	POP	AX
	IRET
	ORG 	2000H
	CLI
	MOV 	AL, 0FDH 
	OUT 	PIC+1, AL 
	MOV 	AL, N_CLK 
	OUT 	PIC+5, AL 
	MOV 	AL, 1 
	OUT	TIMER+1, AL 
	MOV	AL, 0 
	OUT 	PIO+3, AL
	OUT 	PIO+1, AL
	OUT 	TIMER, AL
	STI
LAZO: 	JMP 	LAZO
	HLT
	END
